## configs/neo4-rkimg_defconfig
```kconfig
BR2_aarch64=y
BR2_cortex_a72_a53=y

BR2_OPTIMIZE_FAST=y

# base subset is the basic subset of all rootfs, ramdisk.
#  - auto resize ext2 fs
BR2_TARGET_ROOTFS_EXT2_SIZE="256M"

#  - use glibc as the basic libc
BR2_TOOLCHAIN_BUILDROOT_GLIBC=y
#  - Rockchip use 4.4 kernel, so we need 4.4 kernel header
BR2_KERNEL_HEADERS_4_4=y
#  - we use buildroot toolcharn here, may change to custom toolchain in the feature
BR2_TOOLCHAIN_BUILDROOT_CXX=y

#  - specify this is rockchip package
BR2_PACKAGE_ROCKCHIP=y
BR2_PACKAGE_RK3399=y

#  - show other busybox config
BR2_PACKAGE_BUSYBOX_SHOW_OTHERS=y

#  - we need to support various rootfs, cpio for ramdisk, ext2/4 for large system, squashfs for small system
#BR2_TARGET_ROOTFS_CPIO=y
#BR2_TARGET_ROOTFS_CPIO_GZIP=y
#BR2_TARGET_ROOTFS_SQUASHFS=y

BR2_TARGET_ROOTFS_EXT2=y
BR2_TARGET_ROOTFS_EXT2_4=y

# extra base subset is the basic subset of all rootfs, ramdisk.
#  - we have to use eudev, because wayland need udev support
BR2_ROOTFS_DEVICE_CREATION_DYNAMIC_EUDEV=y

#  - vensor storage tool is used to r/w SN, wifi/bt/lan mac
BR2_PACKAGE_VENDOR_STORAGE=y

#  - usb device package used to init and config udc like adb and usb mass storage
BR2_PACKAGE_USBDEVICE=y

#  - usbmount used to mount usb disk to /media/ when it plug in
#BR2_PACKAGE_USBMOUNT=y

#  - input event daemon used to handle key event, ie. power on/off system
BR2_PACKAGE_INPUT_EVENT_DAEMON=y

#  - upower used to monitor the power state of system
BR2_PACKAGE_UPOWER=y

#  - pm utils used to suspend/resume system
BR2_PACKAGE_PM_UTILS=y

#  - we need to use fsck and resize2fs to check and extend ext2/4 file system when the first time system boot up
BR2_PACKAGE_E2FSPROGS=y
BR2_PACKAGE_E2FSPROGS_FSCK=y
BR2_PACKAGE_E2FSPROGS_RESIZE2FS=y

#  - we need to use dostool, mkfs.fat to format fat file system when the first time system boot up
BR2_PACKAGE_DOSFSTOOLS=y
BR2_PACKAGE_DOSFSTOOLS_MKFS_FAT=y
#  - partinit is a set of script. it will create /dev/block/by-name for internal emmc and nand flash device partition. check if /oem and /userdata is fat/ext2/ext4, deside to resize it or format it when the first time systm boot up. create link for first usb disk. auto mount sd card
BR2_PACKAGE_PARTINIT=y

#  - update tool is a command used to write factory reset or ota update command to /misc, then reboot system
#  - after that, uboot will read command from /misc and boot up recovery image
BR2_PACKAGE_UPDATE=y
BR2_PACKAGE_LIBMALI=y

# video_mpp subset is user space library for harware acceleration of video decoding and encoding
#  - user space library for use vpu to do video decoding and encoding
#BR2_PACKAGE_MPP=y
#  - we use drm for memory allocate
#BR2_PACKAGE_MPP_ALLOCATOR_DRM=y

#  - user space library for use rga to do image zoom in/out, rotate, etc
#BR2_PACKAGE_LINUX_RGA=y

# rockchip provided ...
BR2_PACKAGE_RKWIFIBT_COMPATIBLE=y
#  - The rk3399 evb used the ttyS0 by default.
BR2_PACKAGE_RKWIFIBT_BTUART="ttyS0"

# neo4 specific from here on ...

#BR2_TOOLCHAIN_BUILDROOT_WCHAR=y

BR2_GLOBAL_PATCH_DIR="$(BR2_EXTERNAL)/patches"

# uboot
BR2_TARGET_UBOOT=y
BR2_TARGET_UBOOT_BOARD_DEFCONFIG="nanopi_neo4"
BR2_TARGET_UBOOT_BUILD_SYSTEM_KCONFIG=y
BR2_TARGET_UBOOT_CUSTOM_TARBALL=y
BR2_TARGET_UBOOT_CUSTOM_TARBALL_LOCATION="$(call github,ChiaYen-Kan,u-boot.neo4,4a0320d3a997a01136b766f16953d497ca6eb0eb)/u-boot.neo4-4a0320d3a997a01136b766f16953d497ca6eb0eb.tar.gz"
BR2_TARGET_UBOOT_NEEDS_DTC=y
BR2_TARGET_UBOOT_USE_DEFCONFIG=y
BR2_TARGET_UBOOT_VERSION="custom"

# Linux headers same as kernel, a 4.4 series
BR2_KERNEL_HEADERS_AS_KERNEL=y
BR2_PACKAGE_HOST_LINUX_HEADERS_CUSTOM_4_4=y
BR2_PACKAGE_LINUX_HEADERS=y

BR2_LINUX_KERNEL=y
BR2_LINUX_KERNEL_CUSTOM_TARBALL=y
BR2_LINUX_KERNEL_CUSTOM_TARBALL_LOCATION="$(call github,friendlyarm,kernel-rockchip,decbad503ca983f939baca6c19a79117b11f5bd6)/linux-nanopi4-decbad503ca983f939baca6c19a79117b11f5bd6.tar.gz"
BR2_LINUX_KERNEL_USE_DEFCONFIG=y
BR2_LINUX_KERNEL_DEFCONFIG="nanopi4_linux"
BR2_LINUX_KERNEL_IMAGE_TARGET_CUSTOM=y
BR2_LINUX_KERNEL_IMAGE_TARGET_NAME="nanopi4-images"
BR2_LINUX_KERNEL_IMAGE_NAME="kernel.img"
BR2_LINUX_KERNEL_CONFIG_FRAGMENT_FILES="$(BR2_EXTERNAL)/board/nanopi-neo4/kernel.fragment"
BR2_LINUX_KERNEL_PATCH="$(BR2_EXTERNAL)/board/nanopi-neo4/kernel_patchs"
BR2_LINUX_KERNEL_DTS_SUPPORT=y
BR2_LINUX_KERNEL_INTREE_DTS_NAME="rockchip/rk3399-nanopi4-rev04"
#BR2_LINUX_KERNEL_USE_CUSTOM_CONFIG=y
#BR2_LINUX_KERNEL_CUSTOM_CONFIG_FILE="/home/chiayen/neo4/linux-rk3399-default.config"

# their defconfig is nanopi4_linux_defconfig : http://wiki.friendlyarm.com/wiki/index.php/NanoPi_NEO4#Make_Your_Own_OS_Image
# their build is : make ARCH=arm64 nanopi4-images

# buildroot packages

# wifi
#BR2_PACKAGE_WPA_SUPPLICANT=y

BR2_PACKAGE_BUSYBOX_CONFIG_FRAGMENT_FILES="$(BR2_EXTERNAL)/board/nanopi-neo4/busybox.fragment"

# setup options
BR2_ROOTFS_OVERLAY="$(BR2_EXTERNAL)/board/nanopi-neo4/fsoverlay"

BR2_PACKAGE_HOST_GENIMAGE=y
BR2_PACKAGE_HOST_MTOOLS=y

BR2_ROOTFS_POST_BUILD_SCRIPT="$(BR2_EXTERNAL)/board/nanopi-neo4/post-build-rkimg.sh"
BR2_ROOTFS_POST_IMAGE_SCRIPT="support/scripts/genimage.sh"
BR2_ROOTFS_POST_SCRIPT_ARGS="-c $(BR2_EXTERNAL)/board/nanopi-neo4/genimage-rkimg.cfg"

# external packages
#BR2_PACKAGE_NTP=y
#BR2_PACKAGE_NTP_NTPDATE=y

#BR2_PACKAGE_LINUX_PAM=y
#BR2_PACKAGE_OPENSSH=y

BR2_SYSTEM_DHCP="eth0"

BR2_LINUX_KERNEL_NEEDS_HOST_OPENSSL=y
BR2_PACKAGE_ROCKCHIP_RKBIN=y

BR2_PACKAGE_HOST_ROCKCHIP_RKFLASHTOOL=y
```

## configs/neo4_defconfig
```kconfig
BR2_aarch64=y
BR2_cortex_a72_a53=y

# base subset is the basic subset of all rootfs, ramdisk.
#  - auto resize ext2 fs
BR2_TARGET_ROOTFS_EXT2_SIZE="256M"

#  - use glibc as the basic libc
BR2_TOOLCHAIN_BUILDROOT_GLIBC=y
#  - Rockchip use 4.4 kernel, so we need 4.4 kernel header
BR2_KERNEL_HEADERS_4_4=y
#  - we use buildroot toolcharn here, may change to custom toolchain in the feature
BR2_TOOLCHAIN_BUILDROOT_CXX=y

#  - specify this is rockchip package
BR2_PACKAGE_ROCKCHIP=y
BR2_PACKAGE_RK3399=y

#  - show other busybox config
BR2_PACKAGE_BUSYBOX_SHOW_OTHERS=y

#  - we need to support various rootfs, cpio for ramdisk, ext2/4 for large system, squashfs for small system
#BR2_TARGET_ROOTFS_CPIO=y
#BR2_TARGET_ROOTFS_CPIO_GZIP=y
#BR2_TARGET_ROOTFS_SQUASHFS=y

BR2_TARGET_ROOTFS_EXT2=y
BR2_TARGET_ROOTFS_EXT2_4=y

# extra base subset is the basic subset of all rootfs, ramdisk. 
#  - we have to use eudev, because wayland need udev support
BR2_ROOTFS_DEVICE_CREATION_DYNAMIC_EUDEV=y

#  - vensor storage tool is used to r/w SN, wifi/bt/lan mac
BR2_PACKAGE_VENDOR_STORAGE=y

#  - usb device package used to init and config udc like adb and usb mass storage
BR2_PACKAGE_USBDEVICE=y

#  - usbmount used to mount usb disk to /media/ when it plug in
#BR2_PACKAGE_USBMOUNT=y

#  - input event daemon used to handle key event, ie. power on/off system
BR2_PACKAGE_INPUT_EVENT_DAEMON=y

#  - upower used to monitor the power state of system
BR2_PACKAGE_UPOWER=y

#  - pm utils used to suspend/resume system
BR2_PACKAGE_PM_UTILS=y

#  - we need to use fsck and resize2fs to check and extend ext2/4 file system when the first time system boot up
BR2_PACKAGE_E2FSPROGS=y
BR2_PACKAGE_E2FSPROGS_FSCK=y
BR2_PACKAGE_E2FSPROGS_RESIZE2FS=y

#  - we need to use dostool, mkfs.fat to format fat file system when the first time system boot up
BR2_PACKAGE_DOSFSTOOLS=y
BR2_PACKAGE_DOSFSTOOLS_MKFS_FAT=y
#  - partinit is a set of script. it will create /dev/block/by-name for internal emmc and nand flash device partition. check if /oem and /userdata is fat/ext2/ext4, deside to resize it or format it when the first time systm boot up. create link for first usb disk. auto mount sd card
BR2_PACKAGE_PARTINIT=y

#  - update tool is a command used to write factory reset or ota update command to /misc, then reboot system
#  - after that, uboot will read command from /misc and boot up recovery image
BR2_PACKAGE_UPDATE=y
BR2_PACKAGE_LIBMALI=y

# video_mpp subset is user space library for harware acceleration of video decoding and encoding
#  - user space library for use vpu to do video decoding and encoding
#BR2_PACKAGE_MPP=y
#  - we use drm for memory allocate
#BR2_PACKAGE_MPP_ALLOCATOR_DRM=y

#  - user space library for use rga to do image zoom in/out, rotate, etc
#BR2_PACKAGE_LINUX_RGA=y

# rockchip provided ...
BR2_PACKAGE_RKWIFIBT_COMPATIBLE=y
#  - The rk3399 evb used the ttyS0 by default.
BR2_PACKAGE_RKWIFIBT_BTUART="ttyS0"

BR2_PACKAGE_SD_FUSE_RK3399=y

# neo4 specific from here on ...

#BR2_TOOLCHAIN_BUILDROOT_WCHAR=y

BR2_GLOBAL_PATCH_DIR="$(BR2_EXTERNAL)/patches"

# uboot
BR2_TARGET_UBOOT=y
BR2_PACKAGE_HOST_UBOOT_TOOLS=y
BR2_TARGET_UBOOT_BOARDNAME="rk3399"
BR2_TARGET_UBOOT_CUSTOM_TARBALL=y
BR2_TARGET_UBOOT_CUSTOM_TARBALL_LOCATION="$(call github,flatmax,u-boot.neo4,c4974f0b7adf419c378944c595ec6e782798896c)/u-boot.neo4-c4974f0b7adf419c378944c595ec6e782798896c.tar.gz"
BR2_TARGET_UBOOT_NEEDS_ATF_BL31=y

BR2_TARGET_UBOOT_NEEDS_DTC=y

# Linux headers same as kernel, a 4.4 series
BR2_KERNEL_HEADERS_AS_KERNEL=y
BR2_PACKAGE_HOST_LINUX_HEADERS_CUSTOM_4_4=y
BR2_PACKAGE_LINUX_HEADERS=y

BR2_LINUX_KERNEL=y
BR2_LINUX_KERNEL_CUSTOM_TARBALL=y
BR2_LINUX_KERNEL_CUSTOM_TARBALL_LOCATION="$(call github,friendlyarm,kernel-rockchip,nanopi4-linux-v4.4.y)/linux-nanopi4-linux-v4.4.y.tar.gz"

BR2_LINUX_KERNEL_USE_DEFCONFIG=y
BR2_LINUX_KERNEL_DEFCONFIG="nanopi4_linux"

BR2_LINUX_KERNEL_IMAGE_TARGET_CUSTOM=y
BR2_LINUX_KERNEL_IMAGE_TARGET_NAME="nanopi4-images"
#BR2_LINUX_KERNEL_IMAGE_TARGET_NAME="rk3399-nanopi4-rev04.img"
BR2_LINUX_KERNEL_IMAGE_NAME="kernel.img"
BR2_LINUX_KERNEL_CONFIG_FRAGMENT_FILES="$(BR2_EXTERNAL)/configs/kernel.fragment"
#BR2_LINUX_KERNEL_LZ4=y

BR2_LINUX_KERNEL_PATCH="/home/chiayen/neo4/rk3399-default"
#BR2_LINUX_KERNEL_USE_CUSTOM_CONFIG=y
#BR2_LINUX_KERNEL_CUSTOM_CONFIG_FILE="/home/chiayen/neo4/linux-rk3399-default.config"

# their defconfig is nanopi4_linux_defconfig : http://wiki.friendlyarm.com/wiki/index.php/NanoPi_NEO4#Make_Your_Own_OS_Image
# their build is : make ARCH=arm64 nanopi4-images

# buildroot packages

# wifi
#BR2_PACKAGE_WPA_SUPPLICANT=y

BR2_PACKAGE_BUSYBOX_CONFIG_FRAGMENT_FILES="$(BR2_EXTERNAL)/configs/busybox.fragment"

# setup options
BR2_ROOTFS_OVERLAY="$(BR2_EXTERNAL)/overlays"

BR2_PACKAGE_HOST_GENIMAGE=y
BR2_PACKAGE_HOST_MTOOLS=y
BR2_ROOTFS_POST_BUILD_SCRIPT=""

BR2_ROOTFS_POST_IMAGE_SCRIPT="$(BR2_EXTERNAL)/board/nanopi-neo4/post-build.sh"

# external packages
#BR2_PACKAGE_NTP=y
#BR2_PACKAGE_NTP_NTPDATE=y

#BR2_PACKAGE_LINUX_PAM=y
#BR2_PACKAGE_OPENSSH=y

BR2_SYSTEM_DHCP="eth0"

BR2_LINUX_KERNEL_NEEDS_HOST_OPENSSL=y
```

## package/idbloader/Config.in
```kconfig
config BR2_PACKAGE_IDBLOADER
        bool "idbloader"
        help
          idbloader for u-boot 2014.10

          https://github.com/friendlyarm/sd-fuse_rk3399
```

## package/rockchip-rkflashtool/Config.in
```kconfig
config BR2_PACKAGE_HOST_ROCKCHIP_RKFLASHTOOL
	bool "rockchip rkflashtool"
	help
	  rockchip rkflashtool
```
